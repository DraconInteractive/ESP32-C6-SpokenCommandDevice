## camera-firmware/main/Kconfig.projbuild
```kconfig
menu "TimerCamera command device"

config TIMERCAM_COMMAND_SERVER_URL
    string "Command server base URL"
    default "http://192.168.4.20:8080"
    help
        Base URL for the local command server, for example
        http://192.168.4.20:8080.

endmenu
```

## display-firmware/main/Kconfig.projbuild
```kconfig
menu "Spoken command display"

config DISPLAY_NODE_WIFI_SSID
    string "Wi-Fi SSID"
    default ""
    help
        Home Wi-Fi network SSID used by the display-only ESP32-S3 node.

config DISPLAY_NODE_WIFI_PASSWORD
    string "Wi-Fi password"
    default ""
    help
        Home Wi-Fi password. Leave empty for an open network or when Wi-Fi is
        intentionally disabled during local hardware testing.

config DISPLAY_NODE_SERVER_URL
    string "Command server base URL"
    default "http://192.168.1.100:8080"
    help
        Base URL for the local command bridge server, without a trailing slash.

endmenu
```

## firmware/main/Kconfig.projbuild
```kconfig
menu "Spoken command device"

config SPOKEN_COMMAND_WIFI_SSID
    string "Wi-Fi SSID"
    default ""
    help
        Home Wi-Fi network SSID used by the ESP32-C6 command device.

config SPOKEN_COMMAND_WIFI_PASSWORD
    string "Wi-Fi password"
    default ""
    help
        Home Wi-Fi password. Leave empty for an open network or when Wi-Fi is
        intentionally disabled during local hardware testing.

config SPOKEN_COMMAND_SERVER_URL
    string "Command server audio endpoint"
    default "http://192.168.1.100:8080/audio/command"
    help
        Full URL for the local command bridge server.

config SPOKEN_COMMAND_CAPTURE_MS
    int "Command capture safety cap in milliseconds"
    range 500 60000
    default 10000
    help
        Maximum length of microphone audio streamed while the interaction
        button is held. Audio is sent as signed 16-bit little-endian mono PCM
        at 16 kHz.

endmenu
```

## firmware/sdkconfig.defaults
```kconfig
CONFIG_IDF_TARGET="esp32c6"
CONFIG_ESP_CONSOLE_USB_SERIAL_JTAG=y
CONFIG_ESPTOOLPY_FLASHSIZE_16MB=y
CONFIG_ESPTOOLPY_FLASHSIZE="16MB"
CONFIG_ESPTOOLPY_MONITOR_BAUD=115200
CONFIG_LOG_DEFAULT_LEVEL_INFO=y
CONFIG_PARTITION_TABLE_CUSTOM=y
CONFIG_PARTITION_TABLE_CUSTOM_FILENAME="partitions.csv"
CONFIG_PARTITION_TABLE_FILENAME="partitions.csv"
```
